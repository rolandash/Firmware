## boards/airmind/mindracer_gen3_finch/src/patch/Kconfig.patch
```kconfig
--- a/Kconfig
+++ b/Kconfig.2
@@ -1399,8 +1399,13 @@
 	default n
 	depends on STM32F7_HAVE_ETHRNET
 	select NETDEVICES
-	select ARCH_HAVE_PHY
-	select STM32F7_HAVE_PHY_POLLED
+    select ARCH_HAVE_PHY if !STM32F7_RMII_DIRECT
+    select STM32F7_PHY_POLLING if !STM32F7_RMII_DIRECT
+
+config STM32F7_RMII_DIRECT
+    bool "RMII Direct connection mode"
+    default n
+    depends on STM32F7_RMII
 
 config STM32F7_FMC
 	bool "FMC"
```

## boards/airmind/mindracer_gen3_redpoll/src/patch/Kconfig.patch
```kconfig
--- a/Kconfig
+++ b/Kconfig
@@ -551,8 +551,13 @@
 	default n
 	depends on STM32H7_HAVE_ETHERNET
 	select NETDEVICES
-	select ARCH_HAVE_PHY
-	select STM32H7_HAVE_PHY_POLLED
+	select ARCH_HAVE_PHY if !STM32H7_RMII_DIRECT
+	select STM32H7_HAVE_PHY_POLLED if !STM32H7_RMII_DIRECT 
+
+config STM32H7_RMII_DIRECT
+	bool "RMII Direct connection mode"
+	default n
+	depends on STM32H7_RMII
 
 config STM32H7_FMC
 	bool "FMC"
```
